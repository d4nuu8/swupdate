## fs/Kconfig
```kconfig
# SPDX-FileCopyrightText: 2021 Weidmueller Interface GmbH & Co. KG
#
# SPDX-License-Identifier: GPL-2.0-only

if DISKFORMAT
config FAT_FILESYSTEM
	bool "FAT file system creation support"
	default n
	help
	  Enable support for creating FAT file systems.

config EXT_FILESYSTEM
	bool "EXT2 / EXT3 / EXT4 file system creation support"
	default n
	help
	  Enable support for creating EXT file systems.

config BTRFS_FILESYSTEM
	bool "BTRFS file system creation support"
	default n
	help
	  Enable support for creating BTRFS file systems.

config BTRFS_FILESYSTEM_USELIBMKFS
	bool "Use modified source from btrfs tool to be linked as lib"
	default n
	depends on BTRFS_FILESYSTEM
	help
	  This requires at the moment a patched version of btrfs-tool to export
	  mkfs.btrf as library.

endif
```
